## nemu/configs/riscv32e-ref_defconfig
```kconfig
CONFIG_ISA_riscv=y
CONFIG_RVE=y
CONFIG_TARGET_SHARE=y
CONFIG_ENGINE_INTERPRETER=y
CONFIG_MSIZE=0x8000000
# CONFIG_MEM_RANDOM is not set
# CONFIG_DEVICE is not set
# CONFIG_TRACE is not set
```
